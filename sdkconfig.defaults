## sdkconfig.defaults
```kconfig
# WiFi Configuration
CONFIG_ESP32_WIFI_ENABLED=y
CONFIG_ESP32_WIFI_STATIC_RX_BUFFER_NUM=10
CONFIG_ESP32_WIFI_DYNAMIC_RX_BUFFER_NUM=32
CONFIG_ESP32_WIFI_DYNAMIC_TX_BUFFER_NUM=32

# HTTP Server Configuration
CONFIG_HTTPD_MAX_REQ_HDR_LEN=1024
CONFIG_HTTPD_MAX_URI_LEN=512

# Log Level Configuration
CONFIG_LOG_DEFAULT_LEVEL_INFO=y
CONFIG_LOG_DEFAULT_LEVEL=3

# FreeRTOS Configuration
CONFIG_FREERTOS_HZ=1000

# MQTT Configuration
CONFIG_MQTT_PROTOCOL_311=y
CONFIG_MQTT_TRANSPORT_SSL=y
CONFIG_MQTT_TRANSPORT_WEBSOCKET=y
CONFIG_MQTT_TRANSPORT_WEBSOCKET_SECURE=y
CONFIG_MQTT_USE_CUSTOM_CONFIG=y
CONFIG_MQTT_TASK_CORE_SELECTION_ENABLED=y
CONFIG_MQTT_TASK_CORE_SELECTION=1
CONFIG_MQTT_TASK_PRIORITY=5
CONFIG_MQTT_TASK_STACK_SIZE=6144
CONFIG_MQTT_BUFFER_SIZE=1024
CONFIG_MQTT_TCP_DEFAULT_PORT=1883
CONFIG_MQTT_SSL_DEFAULT_PORT=8883
CONFIG_MQTT_WS_DEFAULT_PORT=80
CONFIG_MQTT_WSS_DEFAULT_PORT=443
CONFIG_MQTT_KEEPALIVE_TICK=y
CONFIG_MQTT_KEEPALIVE_TICK_DEFAULT=120
CONFIG_MQTT_RECONNECT_TIMEOUT=10
CONFIG_MQTT_QUEUE_BUFFER_SIZE_WORD=1024
CONFIG_MQTT_SKIP_PUBLISH_IF_DISCONNECTED=y
CONFIG_MQTT_REPORT_DELETED_MESSAGES=y
CONFIG_MQTT_USE_CUSTOM_CONFIG=y
CONFIG_MQTT_OUTBOX_EXPIRED_TIMEOUT_MS=30000
```
